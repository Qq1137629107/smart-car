/*************************************************************************************************************
单元功能：***STC15系列nRF24L01P无线驱动***
文件名称：NRF24L01P.c
代码整理：闫春林----2018年3月25日
免责声明：该程序仅用于学习与交流，不得用于商业用途，不对因使用本代码而产生的任何后果负任何责任
规范说明：为便于阅读，函数名、全局变量使用大驼峰，局部变量使用小驼峰，常量名使用全大写
调用方法：本机地址为全局变量SelfAddr，频道、功率、速率通过公共函数RF24_RfSetup设置
		  功率配置值适应台产SI24R1芯片的模块及nRF24L01P+PA的亿佰特大功率模块，根据使用模块选择对应的功率参数配置
*************************************************************************************************************/
#include "nRF24L01P.h"


U8 SelfAddr[TX_ADR_WIDTH] = {0x01, 0x01, 0x01, 0x01, 0x01};				//本机硬件地址



/**************************************************************************************************************************/
/*=========================================================私有函数=======================================================*/
/**************************************************************************************************************************/

/*-----------------------------------------------------------------------------
函数名称：SPI_RW
输入参数：byte：待发送的一个字节数据
返回数据：收到的一个字节数据
功能描述：模拟SPI接口通讯收发一体化函数
------------------------------------------------------------------------------*/
U8 SPI_RW(U8 byte){
	U8 i;
	for(i=0; i<8; i++)
	{
		if(byte & 0x80)
			MOSI = 1;
		else
			MOSI = 0;
		byte = (byte << 1);
		SCK = 1;
		byte |= MISO;
		SCK = 0;
	}
	return byte;
}

/*-----------------------------------------------------------------------------
函数名称：nRF24L01P_Write_Reg
输入参数：reg：寄存器映射地址（格式：WRITE_REG｜reg）；value：待写的寄存器值
功能描述：写状态寄存器的值
------------------------------------------------------------------------------*/
void nRF24L01P_Write_Reg(U8 reg, U8 value){
	CSN = 0;
	SPI_RW(reg);
	SPI_RW(value);
	CSN = 1;
}

/*-----------------------------------------------------------------------------
函数名称：nRF24L01P_Write_Buf
输入参数：reg：寄存器映射地址（格式：WRITE_REG｜reg）；pBuf：待写数据首地址；bytes：写数据字节数
功能描述：写状态寄存器的值
------------------------------------------------------------------------------*/
void nRF24L01P_Write_Buf(U8 reg, const U8 *pBuf, U8 bytes){
	U8 i;

	CSN = 0;                                  			
	SPI_RW(reg);                          
	for(i=0; i<bytes; i++)     
		SPI_RW(*pBuf++);
	CSN = 1;     
}							  					   

/*-----------------------------------------------------------------------------
函数名称：nRF24L01P_Read_Reg
输入参数：reg：寄存器映射地址（格式：READ_REG｜reg）
返回数据：寄存器值
功能描述：读状态寄存器的值（单字节）
------------------------------------------------------------------------------*/
U8 nRF24L01P_Read_Reg(U8 reg){
 	U8 value;

	CSN = 0;    
	SPI_RW(reg);			
	value = SPI_RW(0);
	CSN = 1;              

	return(value);
}

/*-----------------------------------------------------------------------------
函数名称：nRF24L01P_Read_Reg
输入参数：reg：寄存器映射地址（格式：READ_REG｜reg）；pBuf：接收缓冲区的首地址；bytes：读取字节数
功能描述：读状态寄存器的值（多字节）
------------------------------------------------------------------------------*/
void nRF24L01P_Read_Buf(U8 reg, U8 *pBuf, U8 bytes){
	U8 i;

	CSN = 0;                                        
	SPI_RW(reg);                           
	for(i=0; i<bytes; i++)
		pBuf[i] = SPI_RW(0);                   									//读取数据，低字节在前
	CSN = 1;   
}


/**************************************************************************************************************************/
/*=========================================================公有函数=======================================================*/
/**************************************************************************************************************************/

/*-----------------------------------------------------------------------------
函数名称：RF24_RfSetup
输入参数：ch：射频工作频道
功能描述：nRF24L01P+工作频道设置
------------------------------------------------------------------------------*/
void RF24_SetRfCh(U8 ch){
	CE = 0;
	nRF24L01P_Write_Reg(WR_RF_CH, ch);         									//设置变更射频通道
	CE = 1;
}

/*-----------------------------------------------------------------------------
函数名称：RF24_Init
功能描述：nRF24L01P+初始化
------------------------------------------------------------------------------*/
void RF24_Init(){
	SCK = 0; 																	//SPI时钟线拉低
	CSN = 1;																	//片选脚拉高处于未选状态
	CE 	= 0;																	//拉低使能配置，收发时要拉高
	IRQ = 1;																	//中断引脚抬高处于未触发中断状态

	CE = 0;
	nRF24L01P_Write_Reg(WR_SETUP_AW, 0x03);             		  				//设置地址宽度为5字节
	nRF24L01P_Write_Reg(WR_RF_SETUP, RFSETUP);    								//数据传输率、发射功率配置为公共变量RfSetup的值
	nRF24L01P_Write_Reg(WR_EN_AA, 0x01);               							//使能接收通道0自动应答
	nRF24L01P_Write_Reg(WR_EN_RXADDR, 0x01);   									//使能接收通道0
	nRF24L01P_Write_Reg(WR_RX_PW_P0, TX_PLOAD_WIDTH);  							//接收通道0选择和发送通道相同有效数据宽度，仅接收有效
	nRF24L01P_Write_Reg(WR_SETUP_RETR, RETE_VAL);								//自动重发时间间隔和重发次数，仅发送有效
	CE = 1;
}

/*-----------------------------------------------------------------------------
函数名称：RF24_RX_Mode
功能描述：nRF24L01P+设置为接收模式
------------------------------------------------------------------------------*/
void RF24_RX_Mode()
{
	CE = 0;
	nRF24L01P_Write_Buf(WR_RX_ADDR_P0, SelfAddr, TX_ADR_WIDTH);  				//接收设备接收通道0使用和发送设备相同的发送地址
	nRF24L01P_Write_Reg(WR_CONFIG, 0x0F);              							//CRC使能，16位CRC校验，开机，接收模式
	nRF24L01P_Write_Reg(WR_STATUS, 0xFF);  										//清除所有的中断标志位
	CE = 1;                                            							//拉高CE启动接收设备
}						

/*-----------------------------------------------------------------------------
函数名称：RF24_TX_Mode
输入参数：*toAddr：发送目标地址指针
功能描述：nRF24L01P+设置为发送模式
------------------------------------------------------------------------------*/
void RF24_TX_Mode(U8 *toAddr)
{
	CE = 0;
	nRF24L01P_Write_Buf(WR_TX_ADDR, toAddr, TX_ADR_WIDTH);						//写入发送地址
	nRF24L01P_Write_Reg(WR_CONFIG, 0x0E);      									//CRC使能，16位CRC校验，开机，发送模式，屏蔽自动重发中断
	nRF24L01P_Write_Buf(WR_RX_ADDR_P0, toAddr, TX_ADR_WIDTH);					//为了应答接收设备，接收通道0地址和发送地址相同
	nRF24L01P_Write_Reg(WR_STATUS, 0xFF);  										//清除所有的中断标志位
	//CE = 1;
}

/*-----------------------------------------------------------------------------
函数名称：RF24_RxData
输入参数：*rxbuf：保存接收数据的缓冲区指针
返回数据：是否收到数据，1收到，0未收到
功能描述：nRF24L01P+判断是否收到数据，若收到直接取出，应在主循环中调用
------------------------------------------------------------------------------*/
bit RF24_RxData(U8 *rxbuf)
{
	U8 state;

	if(IRQ == 0)																//有中断触发，判断中断可以提高CPU效率，减少SPI通讯量
	{
		state = nRF24L01P_Read_Reg(STATUS);										//读取状态寄存器的值    	  
		nRF24L01P_Write_Reg(WR_STATUS, state);									//清除RX_DS中断标志
		if(state & RX_DR)														//接收到数据
		{
			nRF24L01P_Read_Buf(RD_RX_PLOAD,rxbuf,TX_PLOAD_WIDTH);				//读取数据
			nRF24L01P_Write_Reg(FLUSH_RX,0xFF);									//清除RX FIFO寄存器
			return ON; 
		}
	}	   
	return OFF;																	//没收到任何数据
}

/*-----------------------------------------------------------------------------
函数名称：RF24_TxData
输入参数：*txbuf：待发送数据的缓冲区指针
返回数据：是否发送成功，1发送成功，0发送失败
功能描述：nRF24L01P+发送数据
------------------------------------------------------------------------------*/
bit RF24_TxData(U8 *txbuf)
{
	U8 state;
	
	while(RPD == 1);
	CE=0;																		//CE拉低，使能24L01配置
	nRF24L01P_Write_Buf(WR_TX_PLOAD,txbuf,TX_PLOAD_WIDTH);						//写数据到TX FIFO,32个字节
	CE=1;																		//CE置高，使能发送	   

	while(IRQ == 1);															//等待发送完成
	state=nRF24L01P_Read_Reg(STATUS);  											//读取状态寄存器的值	   
	nRF24L01P_Write_Reg(WR_STATUS, state); 										//清除TX_DS或MAX_RT中断标志
	if(state&TX_DS)																//发送完成
		return ON;
	nRF24L01P_Write_Reg(FLUSH_TX,0xff);											//清除TX FIFO寄存器 
	return OFF;																	//发送失败
}





/*************************************************************************************************************
单元功能：***STC15系列nRF24L01P无线驱动***
文件名称：NRF24L01P.h
代码整理：闫春林----2018年3月25日
免责声明：该程序仅用于学习与交流，不得用于商业用途，不对因使用本代码而产生的任何后果负任何责任
规范说明：为偏于阅读，函数名、全局变量使用大驼峰，局部变量使用小驼峰，常量名使用全大写
调用方法：本机地址为全局变量SelfAddr，频道、功率、速率通过公共函数RF24_RfSetup设置
		  功率配置值适应台产SI24R1芯片的模块及nRF24L01P+PA的亿佰特大功率模块，根据使用模块选择对应的功率参数配置
*******************************************